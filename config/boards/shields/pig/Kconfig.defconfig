## config/boards/shields/pig/Kconfig.defconfig
```kconfig
if SHIELD_PIG_LEFT

config ZMK_KEYBOARD_NAME
    default "pig!"

config ZMK_SPLIT_ROLE_CENTRAL
    default y

endif

if SHIELD_PIG_LEFT || SHIELD_PIG_RIGHT

config ZMK_SPLIT
    default y

endif
```

## config/boards/shields/pig/Kconfig.shield
```kconfig
# Copyright (c) 2020 Pete Johanson
# SPDX-License-Identifier: MIT

config SHIELD_PIG_LEFT
    def_bool $(shields_list_contains,pig_left)

config SHIELD_PIG_RIGHT
    def_bool $(shields_list_contains,pig_right)
```
